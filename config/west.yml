## config/west.yml
```yaml
manifest:
  remotes:
    - name: sumtsui
      url-base: https://github.com/sumtsui
  projects:
    - name: zmk-config-zen-2 # repo name
      remote: sumtsui
      revision: https://github.com/sumtsui/zmk-config-zen-2
      # import: app/west.yml
  self:
    path: config
```
